/dts-v1/;

/ {
	compatible = "brcm,bcm2835", "brcm,bcm2708", "brcm,bcm2709";

	fragment@0 {
		target = <0xffffffff>;

		__overlay__ {
			pinctrl-names = "default";
			pinctrl-0 = <0x1>;

			my_pins {
				brcm,pins = <0x6 0x10 0x14 0x15 0x13 0x5 0x1a 0xd>;
				brcm,function = <0x0 0x0 0x0 0x0 0x0 0x0 0x0 0x0>;
				brcm,pull = <0x2 0x2 0x2 0x2 0x2 0x2 0x2 0x2>;
				linux,phandle = <0x1>;
				phandle = <0x1>;
			};
		};
	};

	fragment@1 {
		target-path = [2f 00];

		__overlay__ {

			tfthat_keys {
				compatible = "gpio-keys";
				#address-cells = <0x1>;
				#size-cells = <0x0>;
				autorepeat;

				button@21 {
					label = "key1";
					linux,code = <0x2>;
					gpios = <0xffffffff 0x15 0x1>;
				};

				button@20 {
					label = "key2";
					linux,code = <0x3>;
					gpios = <0xffffffff 0x14 0x1>;
				};

				button@16 {
					label = "key3";
					linux,code = <0x4>;
					gpios = <0xffffffff 0x10 0x1>;
				};

				button@6 {
					label = "up";
					linux,code = <0x67>;
					gpios = <0xffffffff 0x6 0x1>;
				};

				button@19 {
					label = "joystick down";
					linux,code = <0x6c>;
					gpios = <0xffffffff 0x13 0x1>;
				};

				button@5 {
					label = "joystick left";
					linux,code = <0x69>;
					gpios = <0xffffffff 0x5 0x1>;
				};

				button@26 {
					label = "joystick right";
					linux,code = <0x6a>;
					gpios = <0xffffffff 0x1a 0x1>;
				};

				button@13 {
					label = "joystick press";
					linux,code = <0x1c>;
					gpios = <0xffffffff 0xd 0x1>;
				};
			};
		};
	};

	__fixups__ {
		gpio = "/fragment@0:target:0", "/fragment@1/__overlay__/tfthat_keys/button@21:gpios:0", "/fragment@1/__overlay__/tfthat_keys/button@20:gpios:0", "/fragment@1/__overlay__/tfthat_keys/button@16:gpios:0", "/fragment@1/__overlay__/tfthat_keys/button@6:gpios:0", "/fragment@1/__overlay__/tfthat_keys/button@19:gpios:0", "/fragment@1/__overlay__/tfthat_keys/button@5:gpios:0", "/fragment@1/__overlay__/tfthat_keys/button@26:gpios:0", "/fragment@1/__overlay__/tfthat_keys/button@13:gpios:0";
	};

	__local_fixups__ {

		fragment@0 {

			__overlay__ {
				pinctrl-0 = <0x0>;
			};
		};
	};
};
